// SPDX-License-Identifier: (GPL-2.0+ OR MIT)
/*
 * Copyright (c) 2022 Rockchip Electronics Co., Ltd.
 * Copyright (c) 2023 Radxa Limited.
 *
 */

/dts-v1/;

#include "rk3566-radxa-zero3.dtsi"
//#include "rk3566-radxa-zero3-veyecam2m.dtsi"
//#include "rk3566-radxa-zero3-veyemvcam.dtsi"
#include "rk3566-radxa-zero3-veyegxcam.dtsi"

/ {
	model = "Radxa ZERO 3";
	compatible = "radxa,zero-3e", "radxa,zero3", "rockchip,rk3566";
};

&rgmii_phy1 {
	status = "okay";
};

&gmac1 {
	status = "okay";
};
